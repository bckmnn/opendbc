VERSION ""

NS_ :

BS_:

BU_: XXX

BO_ 194 XXX_Steering: 8 XXX
 SG_ xx_dontknow : 7|16@0+ (1,0) [0|65535] "" XXX

BO_ 570 XXX_Speed: 8 XXX
 SG_ Acceleration : 7|16@0+ (1,0) [0|255] "" XXX

BO_ 1042 XXX_Speed2: 8 XXX
 SG_ Speed : 15|8@0+ (1,0) [0|255] "" XXX

BO_ 281 NEW_MSG_2: 8 XXX

BO_ 808 NEW_MSG_3: 8 XXX

BO_ 530 XXX_RPM: 8 XXX
 SG_ RPM : 23|16@0+ (1,0) [0|65535] "rpm" XXX

BO_ 1544 xxx_pedal: 8 XXX
 SG_ xx_dontKnow2 : 39|16@0+ (0.4,0) [0|65535] "" XXX
 SG_ outside_temp : 7|16@0+ (0.4,-40) [0|65535] "" XXX

BO_ 776 NEW_MSG_1: 8 XXX
 SG_ xxx_pedal_maybe : 23|8@0+ (1,0) [0|255] "" XXX
